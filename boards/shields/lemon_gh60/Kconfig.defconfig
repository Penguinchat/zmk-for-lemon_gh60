## boards/shields/lemon_gh60/Kconfig.defconfig
```kconfig
# Copyright (c) 2020 The ZMK Contributors
# SPDX-License-Identifier: MIT

if SHIELD_LEMON_GH60

config ZMK_KEYBOARD_NAME
    default "lemon_gh60"

endif
```

## boards/shields/lemon_gh60/Kconfig.shield
```kconfig
# Copyright (c) 2020 The ZMK Contributors
# SPDX-License-Identifier: MIT

config SHIELD_LEMON_GH60
    def_bool $(shields_list_contains,lemon_gh60)
```
